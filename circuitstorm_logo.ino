#include <Wire.h>
#include <Adafruit_GFX.h>
#include <Adafruit_SSD1306.h>

// ============================================================
// CIRCUITSTORM OLED INTRO ANIMATION
// ESP32 DOIT DEVKIT V1 + 128x64 I2C SSD1306 OLED
// SDA = GPIO 21
// SCL = GPIO 22
// OLED address = 0x3C
//
// Animation:
// 1. CircuitStorm graphic sweeps in from LEFT
// 2. Moving particle field follows the sweep
// 3. "CIRCUITSTORM" types in with UNEQUAL timing
// 4. Animation pauses, then loops
// ============================================================

#define SCREEN_WIDTH 128
#define SCREEN_HEIGHT 64
#define OLED_RESET -1
#define OLED_ADDR 0x3C

Adafruit_SSD1306 display(SCREEN_WIDTH, SCREEN_HEIGHT, &Wire, OLED_RESET);

// The graphic portion of your uploaded CircuitStorm logo.
// 128 pixels wide x 48 pixels high.
// The original stylized wordmark is intentionally omitted here
// because it is drawn separately with the typing animation.
const uint8_t logoGraphic[] PROGMEM = {
  0x00, 0x00, 0x00, 0x00, 0x00, 0x07, 0xFC, 0x00, 0x1F, 0xFE, 0x00, 0x00, 0x00, 0x00, 0x00, 0x00,
  0x00, 0x00, 0x00, 0x00, 0x00, 0x3F, 0xFF, 0x04, 0x7F, 0xFF, 0xC0, 0x00, 0x00, 0x00, 0x00, 0x00,
  0x00, 0x00, 0x00, 0x00, 0x00, 0x78, 0x03, 0xCF, 0xFF, 0xFF, 0xF0, 0x00, 0x00, 0x00, 0x00, 0x00,
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  0x00, 0x00, 0x00, 0x00, 0x00, 0x00, 0x00, 0xFE, 0x00, 0x00, 0x00, 0x00, 0x00, 0x00, 0x00, 0x00,
  ,
};

struct Particle {
  float x;
  float y;
  float vx;
  uint8_t life;
  uint8_t maxLife;
};

Particle particles[28];

void resetParticles() {
  for (int i = 0; i < 28; i++) {
    particles[i].x = random(-30, 10);
    particles[i].y = random(2, 47);
    particles[i].vx = random(8, 22) / 10.0;
    particles[i].life = random(15, 50);
    particles[i].maxLife = particles[i].life;
  }
}

void updateParticles(float sweepX) {
  for (int i = 0; i < 28; i++) {

    // Move particles from left to right.
    particles[i].x += particles[i].vx;

    // Keep particles concentrated around the advancing sweep.
    if (particles[i].x > sweepX + 12 || particles[i].life == 0) {
      particles[i].x = sweepX - random(0, 25);
      particles[i].y = random(2, 47);
      particles[i].vx = random(8, 22) / 10.0;
      particles[i].life = random(18, 50);
      particles[i].maxLife = particles[i].life;
    }

    if (particles[i].life > 0)
      particles[i].life--;
  }
}

void drawGraphic(uint8_t sweepX) {
  // Draw only the part of the bitmap that has been revealed.
  for (int y = 0; y < 48; y++) {
    for (int x = 0; x < sweepX; x++) {
      uint8_t b = pgm_read_byte(&logoGraphic[y * 16 + (x >> 3)]);
      if (b & (0x80 >> (x & 7))) {
        display.drawPixel(x, y, SSD1306_WHITE);
      }
    }
  }
}

void drawParticles(float sweepX) {
  for (int i = 0; i < 28; i++) {
    if (particles[i].life == 0)
      continue;

    int x = (int)particles[i].x;
    int y = (int)particles[i].y;

    // Particle head.
    if (x >= 0 && x < 128 && y >= 0 && y < 48)
      display.drawPixel(x, y, SSD1306_WHITE);

    // Small trailing streak.
    if (particles[i].life > particles[i].maxLife / 2) {
      if (x - 1 >= 0)
        display.drawPixel(x - 1, y, SSD1306_WHITE);

      if (random(0, 3) == 0 && x - 2 >= 0)
        display.drawPixel(x - 2, y, SSD1306_WHITE);
    }
  }

  // Bright scanning edge.
  if (sweepX >= 0 && sweepX < 128) {
    for (int y = 4; y < 45; y += 3) {
      if (random(0, 4) != 0)
        display.drawPixel(sweepX, y, SSD1306_WHITE);
    }
  }
}

void typeCircuitStorm() {

  const char *text = "CIRCUITSTORM";
  const int len = 12;

  // Default Adafruit font, size 1:
  // 6 pixels per character -> 72 pixels total.
  const int textWidth = len * 6;
  const int startX = (128 - textWidth) / 2;
  const int textY = 54;

  for (int i = 0; i < len; i++) {

    // Unequal, human-like typing speed.
    // Some characters arrive quickly, others hesitate.
    int delays[] = {
      75, 155, 55, 210, 90, 135,
      60, 185, 80, 240, 70, 170
    };

    // Draw everything typed so far.
    display.clearDisplay();
    display.setTextColor(SSD1306_WHITE);
    display.setTextSize(1);
    display.setCursor(startX, textY);

    for (int j = 0; j <= i; j++) {
      display.write(text[j]);
    }

    // Blinking cursor.
    display.fillRect(startX + (i + 1) * 6, textY + 6, 4, 1, SSD1306_WHITE);

    display.display();

    delay(delays[i]);
  }

  // Cursor blink after typing.
  for (int k = 0; k < 6; k++) {
    display.clearDisplay();

    display.setTextColor(SSD1306_WHITE);
    display.setTextSize(1);
    display.setCursor(startX, textY);
    display.print(text);

    if (k % 2 == 0)
      display.fillRect(startX + textWidth, textY + 6, 4, 1, SSD1306_WHITE);

    display.display();
    delay(180);
  }
}

void playIntro() {

  resetParticles();

  // ----------------------------------------------------------
  // PHASE 1: GRAPHIC SWEEP
  // ----------------------------------------------------------

  const unsigned long animationTime = 1900;
  unsigned long start = millis();

  while (millis() - start < animationTime) {

    unsigned long elapsed = millis() - start;

    // Smooth ease-out movement.
    float t = (float)elapsed / animationTime;
    float eased = 1.0 - pow(1.0 - t, 3.0);

    float sweepX = eased * 128.0;

    display.clearDisplay();

    drawGraphic((uint8_t)sweepX);
    updateParticles(sweepX);
    drawParticles(sweepX);

    display.display();

    delay(25);
  }

  // Make sure the complete graphic is visible.
  display.clearDisplay();
  drawGraphic(128);
  display.display();

  delay(350);

  // ----------------------------------------------------------
  // PHASE 2: TYPING ANIMATION
  // ----------------------------------------------------------

  typeCircuitStorm();

  // Finished logo hold.
  delay(2500);
}

void setup() {
  Serial.begin(115200);

  // ESP32 DevKit V1 I2C.
  Wire.begin(21, 22);

  if (!display.begin(SSD1306_SWITCHCAPVCC, OLED_ADDR)) {
    Serial.println("SSD1306 OLED NOT FOUND!");
    while (true) {
      delay(1000);
    }
  }

  display.clearDisplay();
  display.display();

  randomSeed(esp_random());

  Serial.println("================================");
  Serial.println(" CIRCUITSTORM OLED INTRO");
  Serial.println("================================");
}

void loop() {
  playIntro();
}
